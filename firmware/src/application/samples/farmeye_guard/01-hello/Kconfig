## firmware/src/application/samples/farmeye_guard/01-hello/Kconfig
```kconfig
#当menuconfig中选中了 "WANGLIAN_SAMPLE" , 则会在编译时提供宏定义 
#  #define  HELLOWORLD_MSG "沈阳网联鸿蒙嵌入开发团队"
config HELLOWORLD_MSG
    string
    prompt "set the value of helloworld."
    default "沈阳网联鸿蒙嵌入开发团队"
    depends on WANGLIAN_SAMPLE
```

## firmware/src/application/samples/farmeye_guard/06-led/Kconfig
```kconfig
config LED1_PIN
    int
    prompt "set the led1."
    default 2
    depends on ENABLE_LED

config LED2_PIN
    int
    prompt "set the led2."
    default 3
    depends on ENABLE_LED
```

## firmware/src/application/samples/farmeye_guard/07-beep/Kconfig
```kconfig
config BEEP_PIN
    int
    prompt "set the beep."
    default 0
    depends on ENABLE_BEEP
```

## firmware/src/application/samples/farmeye_guard/11-uart/Kconfig
```kconfig
config UART_BUS
    int
    prompt "Set the UART BUS of the currrent sample.[0~2]"
    default 2
    depends on WANGLIAN_SAMPLE
    help
        This option means the UART BUS of the currrent sample.
        0: UART0
        1: UART1
        2: UART2
```

## firmware/src/application/samples/farmeye_guard/12-dht11/Kconfig
```kconfig
config DHT11_PIN
    int
    prompt "Choose DHT11_PIN pin."
    default 4
    depends on ENABLE_DHT11
```

## firmware/src/application/samples/farmeye_guard/13-adc/Kconfig
```kconfig
config LDR_ADC_CHANNEL
    int
    prompt "set the ldr."
    default 5
    depends on ENABLE_ADC
```

## firmware/src/application/samples/farmeye_guard/14-co2/Kconfig
```kconfig
config CO2_UART_BUS
    int
    prompt "CO2 sensor UART bus (0=UART0, 1=UART1, 2=UART2)"
    default 1
    depends on ENABLE_CO2

config CO2_COLLECT_INTERVAL_MS
    int
    prompt "CO2 collect interval (ms)"
    default 5000
    depends on ENABLE_CO2
```

## firmware/src/application/samples/farmeye_guard/Kconfig
```kconfig
config ENABLE_HELLOWORLD
    bool
    prompt "01-Enable the Test of ENABLE_HELLOWORLD."
    default n
    depends on FARMEYE_GUARD_SAMPLE
    help
        This option means enable the test of helloworld.

if ENABLE_HELLOWORLD
menu "Config HelloWorld"
osource "application/samples/farmeye_guard/01-hello/Kconfig"
endmenu
endif

config ENABLE_LED
    bool
    prompt "06-Enable the Test of ENABLE_LED."
    default n
    depends on FARMEYE_GUARD_SAMPLE
    help
        This option means enable the test of ENABLE_LED.

if ENABLE_LED
menu "Config ENABLE_LED"
osource "application/samples/farmeye_guard/06-led/Kconfig"
endmenu
endif

config ENABLE_BEEP
    bool
    prompt "07-Enable the Test of ENABLE_BEEP."
    default n
    depends on FARMEYE_GUARD_SAMPLE
    help
        This option means enable the test of Beep.

if ENABLE_BEEP
menu "Config ENABLE_BEEP"
osource "application/samples/farmeye_guard/07-beep/Kconfig"
endmenu
endif

config ENABLE_UART
    bool
    prompt "11-Enable the Test of ENABLE_UART."
    default n
    depends on FARMEYE_GUARD_SAMPLE
    help
        This option means enable the test of ENABLE_UART.

if ENABLE_UART
menu "Config UART_test"
osource "application/samples/farmeye_guard/11-uart/Kconfig"
endmenu
endif

config ENABLE_DHT11
    bool
    prompt "12-Enable the Test of ENABLE_DHT11."
    default n
    depends on FARMEYE_GUARD_SAMPLE
    help
        This option means enable the test of ENABLE_DHT11.

if ENABLE_DHT11
menu "Config ENABLE_DHT11"
osource "application/samples/farmeye_guard/12-dht11/Kconfig"
endmenu
endif

config ENABLE_ADC
    bool
    prompt "13-Enable the Test of ENABLE_ADC."
    default n
    depends on FARMEYE_GUARD_SAMPLE
    help
        This option means enable the test of ENABLE_ADC.

if ENABLE_ADC
menu "Config ENABLE_ADC"
osource "application/samples/farmeye_guard/13-adc/Kconfig"
endmenu
endif

config ENABLE_CO2
    bool
    prompt "14-Enable the Test of CO2 Sensor."
    default n
    depends on FARMEYE_GUARD_SAMPLE
    help
        This option means enable the CO2 sensor module.

if ENABLE_CO2
menu "Config CO2"
osource "application/samples/farmeye_guard/14-co2/Kconfig"
endmenu
endif

config ENABLE_VOICE
    bool
    prompt "19-Enable the Test of ENABLE_VOICE."
    default n
    depends on FARMEYE_GUARD_SAMPLE
    help
        This option means enable the test of ENABLE_VOICE.

if ENABLE_VOICE
menu "Config ENABLE_VOICE"
osource "application/samples/farmeye_guard/19-voice/Kconfig"
endmenu
endif

config ENABLE_FARMEYE_GUARD
    bool
    prompt "Enable FarmEye Guard System."
    default n
    depends on FARMEYE_GUARD_SAMPLE
    help
        This option enables the FarmEye Guard pest & disease monitoring system.

if ENABLE_FARMEYE_GUARD
menu "Config FarmEye Guard"
osource "application/samples/farmeye_guard/main/Kconfig"
osource "application/samples/farmeye_guard/tests/Kconfig"
endmenu
endif
```

## firmware/src/application/samples/farmeye_guard/tests/Kconfig
```kconfig
config TEST_DHT11
    bool
    prompt "Test DHT11 sensor."
    default n
    depends on FARMEYE_GUARD_SAMPLE
    help
        Run DHT11 temperature/humidity sensor unit tests.

config TEST_CO2
    bool
    prompt "Test CO2 sensor (MH-Z19C)."
    default n
    depends on FARMEYE_GUARD_SAMPLE
    help
        Run MH-Z19C CO2 sensor unit tests on UART2.

config TEST_ULTRASONIC
    bool
    prompt "Test ultrasonic sensor (HC-SR04)."
    default n
    depends on FARMEYE_GUARD_SAMPLE
    help
        Run HC-SR04 ultrasonic distance unit tests.

config TEST_LED_BEEP
    bool
    prompt "Test LED blink and beeper."
    default n
    depends on FARMEYE_GUARD_SAMPLE
    help
        Run LED blink and beeper unit tests.

config TEST_RELAY
    bool
    prompt "Test relay control."
    default n
    depends on FARMEYE_GUARD_SAMPLE
    help
        Run spray and irrigation relay unit tests.

config TEST_OLED
    bool
    prompt "Test OLED display (SSD1306)."
    default n
    depends on FARMEYE_GUARD_SAMPLE
    help
        Run SSD1306 OLED display unit tests via I2C.

config TEST_ALARM
    bool
    prompt "Test alarm thresholds and actuators."
    default n
    depends on FARMEYE_GUARD_SAMPLE
    help
        Run alarm bitmask, threshold values, and actuator integration tests.
```
